/*
 * NAME: MATRIX MAX DEMO
 * SHIELD USED : 4 Modules Display Max7219 Led 8x8 
 * Credits CREATION: César J. Fois
 *
 * SHARED:  César J. Fois https://cesarfois.github.io/
 * Versão: 30-11-2018
 * 
 */


#include <MaxMatrix.h>
#include <avr/pgmspace.h>

PROGMEM unsigned char const CH[] = {
3, 8, B00000000, B00000000, B00000000, B00000000, B00000000, // space
1, 8, B01011111, B00000000, B00000000, B00000000, B00000000, // !
3, 8, B00000011, B00000000, B00000011, B00000000, B00000000, // "
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4, 8, B00001000, B00000100, B00001000, B00000100, B00000000, // ~
};

int DIN = 9;   // DIN pin of MAX7219 module
int CS = 8;    // CS pin of MAX7219 module
int CLK = 7;   // CLK pin of MAX7219 module
int maxInUse = 4;
int vel = 3;
int vel2 = 20;
byte buffer[10];

char mensaje1[] = " CJF-"; //Escriba el mensaje a desplegar 
char mensaje2[] ="TECNOLOGIA  ";




MaxMatrix m(DIN, CS, CLK, maxInUse); 


void setup() {
  m.init(); // MAX7219 initialization
  m.setIntensity(0); // initial led matrix intensity, 0-15
}

void loop() {
int vel2 = 20;

//================================================================================================
//=========================================== OPEN ===============================================
//================================================================================================
  
int c1 = 0;
int c2 = 31;
int c3 = 7;
m.clear();          // Clears the display
while (c1 <= 3){
 
    
                   //Display horizontal // (pos hor, pos vert, on/off)
     
      for (int i=c1; i<=c2; i++)  {m.setDot(i,c1,true);    delay(vel); }
      for (int i=c1; i<=c3; i++)  {m.setDot(c2,i,true);    delay(vel); }
      for (int i=c2; i>=c1; i--)  {m.setDot(i,c3,true);    delay(vel); }
      for (int i=c3; i>=c1; i--)  {m.setDot(c1,i,true);    delay(vel); }

     c1++;
     c2--;
     c3--;
  }   

//================================================================================================
//========================================= CLOSED ===============================================
//================================================================================================


      for (int i=3;  i<=28; i++)     {m.setDot(i,4,false);     delay(vel);  }   //horizontal   
      for (int i=28; i>=3;  i--)     {m.setDot(i,3,false);     delay(vel);  }   //horizontal 
      for (int i=3;  i<=5;  i++)     {m.setDot(2,i,false);     delay(vel);  }   //vertical
      for (int i=3;  i<=28; i++)     {m.setDot(i,5,false);     delay(vel);  }   //horizontal       
      
      for (int i=5;  i>=2;  i--)     {m.setDot(29,i,false);    delay(vel);  }   //vertical        
      for (int i=29; i>=2;  i--)     {m.setDot(i,2,false);     delay(vel);  }   //horizontal 
      for (int i=2;  i<=6;  i++)     {m.setDot(1,i,false);     delay(vel);  }   //vertical
      for (int i=2;  i<=29; i++)     {m.setDot(i,6,false);     delay(vel);  }   //horizontal      
      
      for (int i=6;  i>=2;  i--)     {m.setDot(30,i,false);    delay(vel);  }   //vertical      
      for (int i=30; i>=1;  i--)     {m.setDot(i,1,false);     delay(vel);  }   //horizontal 
      for (int i=1;  i<=7;  i++)     {m.setDot(0,i,false);     delay(vel);  }   //vertical
      for (int i=1;  i<=31; i++)     {m.setDot(i,7,false);     delay(vel);  }   //horizontal      
      for (int i=7;  i>=1;  i--)     {m.setDot(31,i,false);    delay(vel);  }   //vertical
      
      for (int i=31; i>=1;  i--)     {m.setDot(i,0,false);     delay(vel);  }   //horizontal

      
//================================================================================================
//====================================== HORIZONTAL LINES ========================================
//================================================================================================
      
    for (int ic=0; ic<=7; ic++)
    for (int il=0; il<=31; il++)  {m.setDot(il,ic,true);    delay(5); }

    for (int ic=7; ic>=0; ic--)
    for (int il=31; il>=0; il--)  {m.setDot(il,ic,false);    delay(5); }

//================================================================================================
//======================================== VERTICAL LINES ========================================
//================================================================================================

   for (int ic=0; ic<=31; ic++)
   for (int il=0; il<=7; il++)  {m.setDot(ic,il,true);    delay(5); } 

   for (int ic=31; ic>=0; ic--)
   for (int il=7; il>=0; il--)  {m.setDot(ic,il,false);    delay(5); } 

   m.clear();          // Clears the displa

//================================================================================================
//============================================ CLOSED 2 ==========================================
//================================================================================================

int c11 = 0;
int c22 = 31;
int c33 = 7;
m.clear();          // Clears the display
while (c11 <= 3){
 
    
                   //Display horizontal // (pos hor, pos vert, on/off)
     
      for (int i=c11; i<=c22; i++)  {m.setDot(i,c11,true);    }
      for (int i=c11; i<=c33; i++)  {m.setDot(c22,i,true);    }
      for (int i=c22; i>=c11; i--)  {m.setDot(i,c33,true);    }
      for (int i=c33; i>=c11; i--)  {m.setDot(c11,i,true);    }

      delay(200);

     c11++;
     c22--;     
     c33--;
}

//================================================================================================
//============================================ OPEN 2 ==========================================
//================================================================================================

int c111 = 0;
int c222 = 31;
int c333 = 7;
int i = 7;

while (c111 <= 3){
 
    
                   //Display horizontal // (pos hor, pos vert, on/off)
     
      for (int i=c111; i<=c222; i++)  {m.setDot(i,c111,false);    }
      for (int i=c111; i<=c333; i++)  {m.setDot(c222,i,false);    }
      for (int i=c222; i>=c111; i--)  {m.setDot(i,c333,false);    }
      for (int i=c333; i>=c111; i--)  {m.setDot(c111,i,false);    }

      delay(200);

     c111++;
     c222--;     
     c333--;
}
//================================================================================================
//============================================ Vertical lines v2 =================================
//================================================================================================
    for (int ic=0; ic<=31; ic++)
     
     if (ic%2 == 0)   {
                      for (int il=0; il<=7; il++) {
                      m.setDot(ic,il,true);
                      delay(vel2); 
                      } 
     }
     else if (ic%2 != 0){
                          for (int i=7; i>=0; i--){
                          m.setDot(ic,i,true);
                         delay(vel2); 
                         
                          }
                          vel2 = vel2 - 1;
                          }
//================================================================================================
//========================================== TEXT MESSAGING ======================================
//================================================================================================                  
                                  
        
     
printStringWithShift(mensaje1, 100);       // El ultimo termino se usa para la velocidad del mensaje 
printStringWithShift(mensaje2, 100);



 

}
//================================================================================================
//============================================ FUNCTIONS =========================================
//================================================================================================      

void printCharWithShift(char c, int shift_speed){    // Imprime caracteres
  if (c < 32) return;
  c -= 32;
  memcpy_P(buffer, CH + 7*c, 7);
  m.writeSprite(maxInUse*8, 0, buffer);
  m.setColumn(maxInUse*8 + buffer[0], 0);
  
  for (int i=0; i<buffer[0]+1; i++) 
  {
    delay(shift_speed);
    m.shiftLeft(false, false);
  }
}

void printStringWithShift(char* s, int shift_speed){        // Imprime cadena de caracteres
  while (*s != 0){
    printCharWithShift(*s, shift_speed);
    s++;
  }
}

void printString(char* s)                            // Imprime cadena
{
  int col = 0;
  while (*s != 0)
  {
    if (*s < 32) continue;
    char c = *s - 32;
    memcpy_P(buffer, CH + 7*c, 7);
    m.writeSprite(col, 0, buffer);
    m.setColumn(col + buffer[0], 0);
    col += buffer[0] + 1;
    s++;
  }
}
